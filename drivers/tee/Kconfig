## drivers/tee/Kconfig
```kconfig
# Generic Trusted Execution Environment Configuration
config TEE
	bool "Trusted Execution Environment support"
	depends on (ARM && (ARM64 || CPU_V7A)) || SANDBOX
	select ARM_SMCCC if ARM
	help
	  This implements a generic interface towards a Trusted Execution
	  Environment (TEE). A TEE is a trusted OS running in some secure
	  environment, for example, TrustZone on ARM cpus, or a separate
	  secure co-processor etc. See also:
	  https://en.wikipedia.org/wiki/Trusted_execution_environment

if TEE

menu "TEE drivers"

config SANDBOX_TEE
	bool "Sandbox TEE emulator"
	depends on SANDBOX
	default y
	help
	  This emulates a generic TEE needed for testing including the AVB
	  TA.

source "drivers/tee/optee/Kconfig"

endmenu

endif
```

## drivers/tee/optee/Kconfig
```kconfig
# OP-TEE Trusted Execution Environment Configuration
config OPTEE
	bool "OP-TEE"
	depends on ARM_SMCCC
	help
	  This implements the OP-TEE Trusted Execution Environment (TEE)
	  driver.
```

## lib/tee-client-api/Kconfig
```kconfig
config TEE_CLIENT_API
	bool "TEE Client API"
	depends on TEE
	help
	  Some description here
```
